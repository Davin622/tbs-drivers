## usb/Kconfig
```kconfig
# SPDX-License-Identifier: GPL-2.0-only

if USB && MEDIA_SUPPORT

menuconfig MEDIA_USB_SUPPORT
	bool "Media USB Adapters"
	help
	  Enable media drivers for USB bus.
	  If you have such devices, say Y.

if MEDIA_USB_SUPPORT


if (MEDIA_ANALOG_TV_SUPPORT || MEDIA_DIGITAL_TV_SUPPORT)
	comment "Analog/digital TV USB devices"
source "usb/cx231xx/Kconfig"
endif


if I2C && MEDIA_DIGITAL_TV_SUPPORT
	comment "Digital TV USB devices"
source "usb/dvb-usb/Kconfig"
endif



endif #MEDIA_USB_SUPPORT
endif #USB
```
